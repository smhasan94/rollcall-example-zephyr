## CMakeLists.txt
```
# SPDX-License-Identifier: Apache-2.0
#
# A minimal application built with sysbuild and MCUboot, after Zephyr's
# samples/sysbuild/with_mcuboot (Apache-2.0, Copyright (c) 2022 Nordic Semiconductor).

cmake_minimum_required(VERSION 3.20.0)

find_package(Zephyr REQUIRED HINTS $ENV{ZEPHYR_BASE})
project(rollcall_example)

# Built through sysbuild only, so MCUboot is always part of the product.
test_sysbuild()

target_sources(app PRIVATE src/main.c)
```

## sysbuild.conf
```
# MCUboot as the bootloader, in overwrite-only mode (as samples/sysbuild/with_mcuboot).
SB_CONFIG_BOOTLOADER_MCUBOOT=y
SB_CONFIG_MCUBOOT_MODE_OVERWRITE_ONLY=y
```

## prj.conf
```kconfig
# west spdx needs the build's metadata (zephyr.meta) for every image.
CONFIG_BUILD_OUTPUT_META=y

# Demo pull request: add Mbed TLS, so the rollcall comment shows the components it adds
# and any vulnerabilities that come with them.
CONFIG_MBEDTLS=y
# Zephyr v4.4.2 compiles Mbed TLS only with its PSA crypto core, which needs an entropy source.
CONFIG_MBEDTLS_PSA_CRYPTO_C=y
CONFIG_ENTROPY_GENERATOR=y
```

## src/main.c
```c
/*
 * Copyright (c) 2022 Nordic Semiconductor
 * Copyright (c) 2026 Sharukh Hasan
 *
 * SPDX-License-Identifier: Apache-2.0
 *
 * After Zephyr's samples/sysbuild/with_mcuboot.
 */

#include <zephyr/kernel.h>
#include <zephyr/linker/linker-defs.h>

int main(void)
{
	printk("Address of image %p\n", (void *)__rom_region_start);
	printk("rollcall example on %s\n", CONFIG_BOARD);
	return 0;
}
```
